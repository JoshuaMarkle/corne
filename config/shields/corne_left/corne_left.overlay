/* corn_left.overlay
 * explicit GPIO list for left half
 * reroute broken GPIO on my board
 */
#include "corne.dtsi"

&kscan0 {
	/* rows – repeat values from corne.dtsi just to make this file self‑contained */
	row-gpios =
		<&pro_micro  4 GPIO_ACTIVE_HIGH>,
		<&pro_micro  5 GPIO_ACTIVE_HIGH>,
		<&pro_micro  6 GPIO_ACTIVE_HIGH>,
		<&pro_micro  7 GPIO_ACTIVE_HIGH>;

	/* columns – six scan outputs for the left half */
	col-gpios =
		<&pro_micro 21 GPIO_ACTIVE_HIGH>,
		<&pro_micro 20 GPIO_ACTIVE_HIGH>,
		<&pro_micro 19 GPIO_ACTIVE_HIGH>,
		<&pro_micro 18 GPIO_ACTIVE_HIGH>,
		<&pro_micro 15 GPIO_ACTIVE_HIGH>,
		<&pro_micro 14 GPIO_ACTIVE_HIGH>;
};
